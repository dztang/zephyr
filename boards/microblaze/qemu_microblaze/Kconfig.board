## boards/microblaze/qemu_microblaze/Kconfig.board
```kconfig
# Copyright (c) 2023 Advanced Micro Devices, Inc. (AMD)
# Copyright (c) 2023 Alp Sayin <alpsayin@gmail.com>
# SPDX-License-Identifier: Apache-2.0


config BOARD_QEMU_MICROBLAZE
	bool "MicroBlaze Demo QEMU Emulator"
	depends on SOC_XLNX_MICROBLAZE_DEMO
	select QEMU_TARGET
```

## boards/microblaze/qemu_microblaze/Kconfig.defconfig
```kconfig
# Copyright (c) 2023 Advanced Micro Devices, Inc. (AMD)
# Copyright (c) 2023 Alp Sayin <alpsayin@gmail.com>
# SPDX-License-Identifier: Apache-2.0


if BOARD_QEMU_MICROBLAZE

config BOARD
	default "qemu_microblaze"

endif # BOARD_QEMU_MICROBLAZE
```

## boards/nxp/frdm_ke15z/Kconfig
```kconfig
# FRDM-KE15Z board configuration
# Copyright 2024 NXP
# SPDX-License-Identifier: Apache-2.0

if BOARD_FRDM_KE15Z

config BOARD_FRDM_KE15Z_FLEXIO_CLKOUT
	bool "CLKOUT signal on FlexIO header"
	help
	  Enable the CLKOUT signal on FlexIO header pin 7 (PTE10).

endif # BOARD_FRDM_KE15Z
```

## boards/shields/x_nucleo_wb05kn1/Kconfig.defconfig
```kconfig
# Copyright (c) 2024 STMicroelectronics
# SPDX-License-Identifier: Apache-2.0

if SHIELD_x_nucleo_wb05kn1

if BT

config SPI
	default y

config SPI_STM32_INTERRUPT
	default y
	depends on SPI

choice BT_HCI_BUS_TYPE
	default BT_SPI if (DT_HAS_ST_HCI_SPI_V2_ENABLED || DT_HAS_ST_HCI_SPI_V1_ENABLED)
	default BT_H4
endchoice

config BT_BLUENRG_ACI
	default y

# Disable Flow control
config BT_HCI_ACL_FLOW_CONTROL
	default n

endif # BT

endif
```

## boards/shields/x_nucleo_wb05kn1/Kconfig.shield
```kconfig
# Copyright (c) 2024 STMicroelectronics
# SPDX-License-Identifier: Apache-2.0

config SHIELD_x_nucleo_wb05kn1
	def_bool $(shields_list_contains,x_nucleo_wb05kn1)
```

## dts/bindings/arm/nxp,hci-ble.yaml
```yaml
# Copyright 2023 NXP
# SPDX-License-Identifier: Apache-2.0

description: HCI BLE information

compatible: "nxp,hci-ble"

include: base.yaml

properties:
  interrupts:
    required: true
```

## dts/bindings/gpio/adi,max22190-gpio.yaml
```yaml
# Copyright (c) 2010-2024 Analog Devices Inc.
# Copyright (c) 2024 BayLibre SAS
# SPDX-License-Identifier: Apache-2.0

description: |
  ADI MAX22190 octal industrial Input with advanced diagnostic
  capabilities like Wire break and over/under volatage.
  Fiter configuration could be done on per channel bases, which
  mean WB functionality and fiters could be set.Reffering to:
  filter-wbes = <CH0 CH1 CH2 ... CH7 >  for wire break
  To ebale wire break set 1 else 0. Same principal is followed for:
  filter-fbps and filter-dealys.
  Sample binding
  &sdp_spi {
    status = "okay";
    pinctrl-names = "default";
    max22190_gpio0: max22190_gpio@0 {
      compatible = "adi,max22190-gpio";
      reg = <0>;

      spi-max-frequency = <1000000>;
      status = "okay";

      gpio-controller;
      #gpio-cells = <2>;
      ngpios = <8>;
      status = "okay";

      max22190-mode = <1>; // modes range from 0-4

      drdy-gpios = <&gpioj 12 GPIO_ACTIVE_LOW>; /* SDP-GPIO5 - PMOD-PIN8 */
      fault-gpios = <&gpioc 11 GPIO_ACTIVE_LOW>; /* SDP-SERIAL_INT - PMOD-PIN7 */
      latch-gpios = <&gpioj 13 GPIO_ACTIVE_LOW>; /* SDP-GPIO6 - PMOD-PIN9 */

      filter-wbes = <1 0 0 0  0 0 0 0>; // wirebreak WBEx
      filter-fbps = <0 0 0 0  0 0 0 0>; // programmable filter INx
      filter-delays = <50 100 400 800 1600 3200 12800 20000>; // 1000 us == 1ms
    };
  };

compatible: "adi,max22190-gpio"

properties:
  "#gpio-cells":
    const: 2
  ngpios:
    type: int
    required: true
    const: 8
    description: Number of gpios supported
  drdy-gpios:
    description: Ready pin which show when chip is ready
    type: phandle-array
  fault-gpios:
    description: |
      Fault pin indicates when there is Fault state in either FAULT1 or FAULT2
      bothe of which are cleaned on read once problem is not persistent
    type: phandle-array
  latch-gpios:
    description: |
      Latch the data so it could be read (partially duplicate CS)
    type: phandle-array
  max22190-mode:
    type: int
    default: 1
    required: true
    enum:
      - 0
      - 1
      - 2
      - 3
    description: |
      Default mode set to 1, because in MAX22190PMB devkit this is hardwired
      mode set by manifacturer.
      max22190 mode is configured from M0 and M1 pins with
      pull up or down resistors.
      MODE| M1| M0| FRAME  | CRC | DAISY CHAIN
      ----+---+---+--------+-----+------------
        0 | 0 | 0 | 24-bit | yes | no
        1 | 0 | 1 | 16-bit | no  | no
        2 | 1 | 0 | 24-bit | yes | yes
        3 | 1 | 1 | 16-bit | no  | yes
  filter-wbes:
    type: array
    default: [1, 1, 1, 1, 1, 1, 1, 1]
    description: |
      Wire break functionality is enabled by default on all channels.
      WBE bit in all Filter registers stand for wire break enable on each
      channel, so to enable WB functionality set 1.
      If WB on specific channel is disabled , FAULT will not be rised in case
      wire is cut.
      - 1 wire break enable
      - 0 wire break disable
      channels indentation start from CH0...CH7
  filter-fbps:
    type: array
    default: [1, 1, 1, 1, 1, 1, 1, 1]
    description: |
      By default all channels are set to bypass mode from documentation.
      Enable or disable filter
      - 1 mean bypass
      - 0 mean filter is used
      channels indentation start from CH0...CH7
  filter-delays:
    type: array
    default: [20000, 20000, 20000, 20000, 20000, 20000, 20000, 20000]
    description: |
      Default value in documentation is 20ms which corespond to 200000us.
      Used to setup filter delay. Values are set in uS. Default value is 20000us = 20ms
      channels indentation start from CH0...CH7

gpio-cells:
  - pin
  - flags

include: [gpio-controller.yaml, spi-device.yaml]
```

## dts/bindings/mbox/st,mbox-stm32-hsem.yaml
```yaml
# Copyright (c) 2024 Celina Sophie Kalus <hello@celinakalus.de>
# SPDX-License-Identifier: Apache-2.0

description: STM32 HSEM MBOX

compatible: "st,mbox-stm32-hsem"

include: [base.yaml, mailbox-controller.yaml]

properties:
  clocks:
    required: true

  interrupts:
    required: true

  st,hsem_ids_tx:
    type: array
    required: true
    description: |
      Set of hardware semaphore IDs to be used for TX channels. For each
      given ID, an MBOX TX channel of the same ID exists.

  st,hsem_ids_rx:
    type: array
    required: true
    description: |
      Set of hardware semaphore IDs to be used for RX channels. For each
      given ID, an MBOX RX channel of the same ID exists.

mbox-cells:
  - channel
```

## dts/bindings/pwm/nxp,flexio-pwm.yaml
```yaml
# Copyright 2024 NXP
# SPDX-License-Identifier: Apache-2.0

description: NXP Flexio PWM controller.
  Each flexio timer can be used for generating one pwm pulse.
  The two PWM modes supported by flexio are chosen based on the selected polarity -
  Dual 8-bit counters PWM mode and Dual 8-bit counters PWM Low mode.

compatible: "nxp,flexio-pwm"

include: [pwm-controller.yaml, pinctrl-device.yaml, base.yaml]

properties:
  pinctrl-0:
    required: true

  pinctrl-names:
    required: true

  "#pwm-cells":
    const: 3

pwm-cells:
  - channel
  # Period in terms of nanoseconds
  - period
  - flags

child-binding:
  description: |
    Flexio PWM channel configuration.

  properties:
    pin-id:
      type: int
      required: true
      description: |
        pin-id should be populated with number 'n' specified in the
        FXIO_D<n> data pin of your board's schematic.

    polarity:
      type: int
      description: |
        Output polarity for PWM channel.

    duty-cycle:
      type: int
      description: |
        Duty-cycle (in ticks) for PWM channel at boot time.

    period:
      type: int
      description: |
        Period (in ticks) is the time of one cycle of the PWM pulse.
        Must be in range [2 ... 65535].

    prescaler:
      type: int
      description: |
        The clock divider for internal counter prescaler.
        - 0: Divide by 1
        - 4: Divide by 16
        - 5: Divide by 256
      enum: [0, 4, 5]
```

## dts/bindings/sdhc/espressif,esp32-sdhc.yaml
```yaml
# Copyright (c) 2024 Espressif Systems (Shanghai) Co., Ltd.
# SPDX-License-Identifier: Apache-2.0

description: Espressif ESP32 SDHC controller

compatible: "espressif,esp32-sdhc"

include: [sdhc.yaml, pinctrl-device.yaml]

properties:
  reg:
    required: true

  pinctrl-0:
    required: true

  pinctrl-names:
    required: true

  slot:
    type: int
    enum:
      - 0
      - 1
    default: 1
    description: |
      SD card slot
      ESP32 peripheral supports two card slots. As slot 0 pins are
      used for communication with internal SPI flash, only slot 1 is
      available for use.

  bus-width:
    type: int
    enum:
      - 1
      - 4
    default: 4
    description: SD bus width in bits

  clk-pin:
    type: int
    default: -1
    description: |
      Clock pin for ESP32 and SoC models with fixed pins for SDIO.
      For devices with GPIO matrix support, configuration shall be done
      using pin control (pinctrl-0 field).

  cmd-pin:
    type: int
    default: -1
    description: |
      Command pin for ESP32 and SoC models with fixed pins for SDIO.
      For devices with GPIO matrix support, configuration shall be done
      using pin control (pinctrl-0 field).

  d0-pin:
    type: int
    default: -1
    description: |
      Data 0 pin for ESP32 and SoC models with fixed pins for SDIO.
      For devices with GPIO matrix support, configuration shall be done
      using pin control (pinctrl-0 field).

  d1-pin:
    type: int
    default: -1
    description: |
      Data 1 pin for ESP32 and SoC models with fixed pins for SDIO.
      For devices with GPIO matrix support, configuration shall be done
      using pin control (pinctrl-0 field).

  d2-pin:
    type: int
    default: -1
    description: |
      Data 2 pin for ESP32 and SoC models with fixed pins for SDIO.
      For devices with GPIO matrix support, configuration shall be done
      using pin control (pinctrl-0 field).

  d3-pin:
    type: int
    default: -1
    description: |
      Data 3 pin for ESP32 and SoC models with fixed pins for SDIO.
      For devices with GPIO matrix support, configuration shall be done
      using pin control (pinctrl-0 field).

  pwr-gpios:
    type: phandle-array
    description: |
      Power pin
      This is a configurable pin to deliver power supply to the SD card.
      It is configured as a GPIO in order to execute power toggles and
      reinitialize the SD slave when necessary.
```

## samples/boards/stm32/i2c_config/sample.yaml
```yaml
sample:
  name: STM32 I2C configuration
tests:
  sample.boards.stm32.i2c_config:
    depends_on: i2c
    tags:
      - drivers
      - i2c
    filter: dt_compat_enabled("st,stm32-i2c-v1") or dt_compat_enabled("st,stm32-i2c-v2")
    platform_allow: nucleo_l152re nucleo_wb55rg b_u585i_iot02a
    harness: console
    harness_config:
      type: multi_line
      regex:
        - "I2C timing value, report to the DTS :"
        - "timings = *"
        - "I2C config: I2C_BITRATE_*"
```

## samples/subsys/ipc/ipc_service/icmsg/boards/stm32h747i_disco.conf
```kconfig
CONFIG_MBOX_STM32_HSEM=y

# This is a temporary workaround, as the cache invalidation in
# ICMsg currently does not work properly on STM32H7.
CONFIG_DCACHE=n
```

## samples/subsys/ipc/ipc_service/icmsg/remote/boards/stm32h747i_disco.conf
```kconfig
CONFIG_MBOX_STM32_HSEM=y

# Per default, the CM4 on the disco board does not provide a logging
# backend. Thus, logging needs to be disabled to avoid the CM4
# crashing.
CONFIG_LOG=n
```

## soc/nxp/imx/imx6sx/Kconfig.defconfig.mcimx6x_m4
```kconfig
# i.MX 6SoloX

# Copyright 2018,2024 NXP
# SPDX-License-Identifier: Apache-2.0

if SOC_MCIMX6X_M4

config FPU
	default y


#By default ROM_START is relocated to address 0 in a 1K region, allowing imx_rproc
#to translate it to TCM_L address
#Select the relocation if the chosen flash is not the TCML
config ROMSTART_RELOCATION_ROM
	default y if $(dt_chosen_reg_addr_hex,$(DT_CHOSEN_Z_FLASH))!=$(dt_nodelabel_reg_addr_hex,tcml)

endif # SOC_MCIMX6X_M4
```

## soc/nxp/imx/imx7d/Kconfig.defconfig.mcimx7d_m4
```kconfig
# iMX7 M4 core series

# Copyright 2017,2024 NXP
# SPDX-License-Identifier: Apache-2.0

if SOC_MCIMX7D_M4

config SYS_CLOCK_HW_CYCLES_PER_SEC
	default 200000000

config GPIO
	default y

#By default ROM_START is relocated to address 0 in a 1K region, allowing imx_rproc
#to translate it to OCRAM_S address
#Select the relocation if the chosen flash is not the OCRAM_S
config ROMSTART_RELOCATION_ROM
	default y if $(dt_chosen_reg_addr_hex,$(DT_CHOSEN_Z_FLASH))!=$(dt_nodelabel_reg_addr_hex,ocram_s_code)


endif # SOC_MCIMX7D_M4
```

## soc/nxp/kinetis/ke1xz/Kconfig
```kconfig
# Kinetis KE1xZ series MCU

# Copyright (c) 2019 Vestas Wind Systems A/S
# Copyright 2024 NXP
# SPDX-License-Identifier: Apache-2.0

config SOC_SERIES_KINETIS_KE1XZ
	select ARM
	select CPU_CORTEX_M0PLUS
	select CPU_CORTEX_M_HAS_SYSTICK
	select CPU_CORTEX_M_HAS_VTOR
	select CLOCK_CONTROL
	select HAS_MCUX
	select HAS_MCUX_FTFX
	select HAS_MCUX_LPI2C
	select HAS_MCUX_LPSPI
	select HAS_MCUX_LPUART
	select HAS_MCUX_PCC
	select HAS_MCUX_RTC
	select HAS_MCUX_SIM
	select HAS_MCUX_ADC12
	select HAS_MCUX_SCG
	select HAS_MCUX_WDOG32
	select HAS_MCUX_FTM
	select HAS_MCUX_LPTMR
	select HAS_MCUX_EDMA
	select HAS_MCUX_ACMP
	select HAS_MCUX_PWT
	select HAS_MCUX_RCM
	select PLATFORM_SPECIFIC_INIT
	select HAS_PM

if SOC_SERIES_KINETIS_KE1XZ

config WDOG_ENABLE_AT_BOOT
	bool "Keep watchdog timer enabled at boot"
	help
	  Keep the watchdog timer enabled at boot with the internal
	  128kHz LPO clock (and a prescaler of 256) as clock
	  source. The application can take over control of the
	  watchdog timer after boot and install a different timeout,
	  if needed.

config WDOG_INITIAL_TIMEOUT
	int "Initial timeout for the watchdog timer in milliseconds"
	depends on WDOG_ENABLE_AT_BOOT && WDOG_INIT
	range 2 131070
	default 2048
	help
	  Initial timeout value for the watchdog timer in
	  milliseconds.

endif # SOC_SERIES_KINETIS_KE1XZ
```

## soc/nxp/kinetis/ke1xz/Kconfig.soc
```kconfig
# Kinetis KE1xF MCU line

# Copyright (c) 2019 Vestas Wind Systems A/S
# Copyright 2024 NXP
# SPDX-License-Identifier: Apache-2.0

config SOC_SERIES_KINETIS_KE1XZ
	bool
	select SOC_FAMILY_KINETIS

config SOC_SERIES
	default "ke1xz" if SOC_SERIES_KINETIS_KE1XZ

config SOC_MKE14Z7
	bool
	select SOC_SERIES_KINETIS_KE1XZ

config SOC_MKE15Z7
	bool
	select SOC_SERIES_KINETIS_KE1XZ

config SOC
	default "mke14z7" if SOC_MKE14Z7
	default "mke15z7" if SOC_MKE15Z7

config SOC_PART_NUMBER_MKE14Z128VLL7
	bool

config SOC_PART_NUMBER_MKE14Z128VLH7
	bool

config SOC_PART_NUMBER_MKE14Z256VLL7
	bool

config SOC_PART_NUMBER_MKE14Z256VLH7
	bool

config SOC_PART_NUMBER_MKE15Z128VLL7
	bool

config SOC_PART_NUMBER_MKE15Z128VLH7
	bool

config SOC_PART_NUMBER_MKE15Z256VLL7
	bool

config SOC_PART_NUMBER_MKE15Z256VLH7
	bool

config SOC_PART_NUMBER
	default "MKE14Z128VLL7" if SOC_PART_NUMBER_MKE14Z128VLL7
	default "MKE14Z128VLH7" if SOC_PART_NUMBER_MKE14Z128VLH7
	default "MKE14Z256VLL7" if SOC_PART_NUMBER_MKE14Z256VLL7
	default "MKE14Z256VLH7" if SOC_PART_NUMBER_MKE14Z256VLH7
	default "MKE15Z128VLL7" if SOC_PART_NUMBER_MKE15Z128VLL7
	default "MKE15Z128VLH7" if SOC_PART_NUMBER_MKE15Z128VLH7
	default "MKE15Z256VLL7" if SOC_PART_NUMBER_MKE15Z256VLL7
	default "MKE15Z256VLH7" if SOC_PART_NUMBER_MKE15Z256VLH7
```

## soc/ti/k3/j721e/Kconfig.soc
```kconfig
# Copyright (C) 2023 BeagleBoard.org Foundation
# Copyright (C) 2023 S Prashanth
#
# SPDX-License-Identifier: Apache-2.0

config SOC_SERIES_J721E
	bool
	select SOC_FAMILY_TI_K3
	help
	  Enable support for the TI J721E SoC series

config SOC_J721E_A72
	bool
	select SOC_SERIES_J721E

config SOC_J721E_R5
	bool
	select SOC_SERIES_J721E

config SOC_SERIES
	default "j721e" if SOC_SERIES_J721E

config SOC
	default "j721e" if SOC_J721E_A72 || SOC_J721E_R5
```
