## subsys/bluetooth/host/classic/Kconfig
```kconfig
# Copyright (c) 2016-2020 Nordic Semiconductor ASA
# Copyright (c) 2015-2016 Intel Corporation
# Copyright 2024 NXP
# SPDX-License-Identifier: Apache-2.0

config BT_CLASSIC
	bool "Bluetooth BR/EDR support [EXPERIMENTAL]"
	depends on BT_HCI_HOST
	select BT_PERIPHERAL
	select BT_CENTRAL
	select BT_SMP
	select BT_L2CAP_DYNAMIC_CHANNEL
	select EXPERIMENTAL
	help
	  This option enables Bluetooth BR/EDR support

if BT_CLASSIC
config BT_MAX_SCO_CONN
	int "Maximum number of simultaneous SCO connections"
	default 1
	range 1 3
	help
	  Maximum number of simultaneous Bluetooth synchronous connections
	  supported. The minimum (and default) number is 1.

config BT_RFCOMM
	bool "Bluetooth RFCOMM protocol support [EXPERIMENTAL]"
	select EXPERIMENTAL
	help
	  This option enables Bluetooth RFCOMM support

config BT_RFCOMM_L2CAP_MTU
	int "L2CAP MTU for RFCOMM frames"
	depends on BT_RFCOMM
	# RX MTU will be truncated to account for the L2CAP PDU header.
	default BT_BUF_ACL_RX_SIZE
	range 23 32767
	help
	  Maximum size of L2CAP PDU for RFCOMM frames.

config BT_RFCOMM_TX_MAX
	int "Maximum number of pending TX buffers for RFCOMM"
	default BT_MAX_CONN
	range BT_MAX_CONN 255
	help
	  Maximum number of pending TX buffers that have an associated
	  sending buf. Normally this can be left to the default value, which
	  is equal to the number of session in the stack-internal pool.

config BT_HFP_HF
	bool "Bluetooth Handsfree profile HF Role support [EXPERIMENTAL]"
	depends on PRINTK
	select BT_RFCOMM
	select EXPERIMENTAL
	help
	  This option enables Bluetooth HF support

config BT_AVDTP
	bool "Bluetooth AVDTP protocol support [EXPERIMENTAL]"
	select EXPERIMENTAL
	help
	  This option enables Bluetooth AVDTP support

config BT_A2DP
	bool "Bluetooth A2DP Profile [EXPERIMENTAL]"
	select BT_AVDTP
	select EXPERIMENTAL
	help
	  This option enables the A2DP profile

if BT_AVDTP

config BT_AVDTP_RTP_VERSION
	int "Bluetooth AVDTP RTP version"
	default 2
	help
	  This option sets the AVDTP RTP protocol version

endif # BT_AVDTP

if BT_A2DP

config BT_A2DP_SOURCE
	bool "Bluetooth A2DP Profile Source Function"
	help
	  This option enables the A2DP profile source function

config BT_A2DP_SINK
	bool "Bluetooth A2DP Profile Sink Function"
	help
	  This option enables the A2DP profile sink function

endif # BT_A2DP

config BT_PAGE_TIMEOUT
	hex "Bluetooth Page Timeout"
	default 0x2000
	range 0x0001 0xffff
	help
	  This option sets the page timeout value. Value is selected as
	  (N * 0.625) ms.

config BT_COD
	hex "Bluetooth Class of Device(CoD)"
	default 0
	help
	  This option sets the class of device.For the list of possible values please
	  consult the following link:
	  https://www.bluetooth.com/specifications/assigned-numbers

endif # BT_CLASSIC
```

## tests/drivers/gpio/gpio_nrf/testcase.yaml
```yaml
common:
  tags: drivers gpio
  depends_on: gpio
  harness: ztest
tests:
  drivers.gpio.gpio_nrf:
    filter: dt_compat_enabled("nordic,nrf-gpio")
    platform_exclude:
      - raytac_mdbt53v_db_40/nrf5340/cpunet
      - actinius_icarus_som/nrf9160/ns
```

## tests/kernel/mem_protect/stackprot/testcase.yaml
```yaml
tests:
  kernel.memory_protection.stackprot:
    arch_exclude:
      - nios2
      - xtensa
      - posix
      - sparc
      - microblaze
    tags:
      - kernel
      - userspace
    ignore_faults: true
```

## tests/lib/lockfree/testcase.yaml
```yaml
tests:
  libraries.lockfree:
    platform_exclude:
      - m5stack_core2
    tags:
      - lockfree
```

## tests/net/vlan/testcase.yaml
```yaml
common:
  depends_on: netif
  min_ram: 32
  tags:
    - net
    - vlan
tests:
  net.vlan.no.headroom:
    extra_configs:
      - CONFIG_NET_PKT_ALLOW_HEADROOM_ALLOCATION=n
  net.vlan.with.headroom:
    extra_configs:
      - CONFIG_NET_PKT_ALLOW_HEADROOM_ALLOCATION=y
```
