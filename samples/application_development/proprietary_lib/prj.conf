## CMakeLists.txt
```
# SPDX-License-Identifier: Apache-2.0

cmake_minimum_required(VERSION 3.20.0)
find_package(Zephyr REQUIRED HINTS $ENV{ZEPHYR_BASE})
project(proprietary_lib)

# defines targets and sources
target_sources(app PRIVATE
	src/main.c
	src/math_ops.c
)
zephyr_include_directories(include)

if(DEFINED ENV{LIB_LOCATION})
	message(STATUS "LIB_LOCATION environment variable defined")

	# contains a "proprietary" library we will link to
	# this should set the INCLUDE_DIR, LIB_DIR and LIB_NAME variables
	add_subdirectory($ENV{LIB_LOCATION} ${CMAKE_CURRENT_BINARY_DIR}/proprietary)

	# this is an example for NatureDSP backend
	target_sources(app PRIVATE
		src/nature_dsp_wrapper.c
	)

	if(INCLUDE_DIR)
		zephyr_include_directories($ENV{LIB_LOCATION}/${INCLUDE_DIR})
	endif()

	if(LIB_DIR AND LIB_NAME)
		zephyr_link_libraries($ENV{LIB_LOCATION}/${LIB_DIR}/${LIB_NAME})
	endif()
else()
	message(STATUS "LIB_LOCATION environment variable NOT defined")
	# this is an example for CMSIS-DSP backend
	target_sources(app PRIVATE
		src/cmsis_dsp_wrapper.c
	)
endif()
```

## sample.yaml
```
sample:
  description: An application that demonstrates
    how to integrate a proprietary library which
    executes math functions on target.
  name: Proprietary Library
tests:
  sample.app_dev.proprietary_lib:
    integration_platforms:
      - native_sim
      - imx8mp_evk/mimx8ml8/adsp
    tags: external
    harness: console
    harness_config:
      type: multi_line
      regex:
        - "Proprietary library example!"
        - "[Library Test]"
```

## prj.conf
```kconfig
CONFIG_STDOUT_CONSOLE=y
CONFIG_REQUIRES_FLOAT_PRINTF=y

#for CMSIS-DSP
CONFIG_REQUIRES_FULL_LIBC=y

CONFIG_CMSIS_DSP=y
CONFIG_CMSIS_DSP_FILTERING=y

# for FFT
CONFIG_CMSIS_DSP_TRANSFORM=y
# for arm_power
CONFIG_CMSIS_DSP_STATISTICS=y
```

## src/main.c
```c
/*
 * Copyright 2024 NXP
 *
 * SPDX-License-Identifier: Apache-2.0
 */

/**
 * Proprietary Library example:
 * calling functions from an out of tree static library
 */

#include <zephyr/kernel.h>
#include <stdio.h>

#include "math_ops.h"

int main(void)
{
	printk("\r\nProprietary library example!\r\n\n");

	test_vec_sum_int16_op();

	test_power_int16_op();

	test_power_int32_op();

	test_fft_op();

	test_iir_op();

	test_fir_blms_op();

	return 0;
}
```
